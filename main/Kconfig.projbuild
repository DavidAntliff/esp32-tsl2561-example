## main/Kconfig.projbuild
```kconfig
menu "esp32-tsl2561-example Configuration"

config I2C_MASTER_SCL
    int "I2C Master SCL GPIO number"
	range 0 34
	default 19
	help
		GPIO number (IOxx) for I2C SCL.

		Some GPIOs are used for other purposes (flash connections, etc.) and cannot be used.

		GPIOs 35-39 are input-only so cannot be used to drive the One Wire Bus.

config I2C_MASTER_SDA
    int "I2C Master SDA GPIO number"
    range 0 34
    default 18
    help
        GPIO number (IOxx) for I2C SDA.

        Some GPIOs are used for other purposes (flash connections, etc.) and cannot be used.

        GPIOs 35-39 are input-only so cannot be used to drive the One Wire Bus.

config TSL2561_I2C_ADDRESS
    hex "I2C Address for TSL2561 device"
    default 0x39
    help
        I2C address for TSL2561 device.
        
        If ADDR Sel pin is tied to GND, the address is 0x29.
        If ADDR Sel pin is floating, the address is 0x39.
        If ADDR Sel pin is tied to VCC, the address is 0x49.

endmenu
```
